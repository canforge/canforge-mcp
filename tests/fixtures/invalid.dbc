VERSION "1.0"

NS_ :

BS_ :

BU_ : KnownNode

BO_ 256 BadMessage: 1 MissingSender
 SG_ OverflowingSignal : 0|16@1+ (1,0) [0|65535] "" MissingReceiver
